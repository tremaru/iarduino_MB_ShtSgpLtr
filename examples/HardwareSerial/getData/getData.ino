// ПРИМЕР ЧТЕНИЯ ДАННЫХ С ПРОВЕРКОЙ ИЗ МОДУЛЯ КЛИМАТИЧЕСКИХ ДАТЧИКОВ:              //
// Чтение данных без проверки доступно в примере "getDataShort"                    //
                                                                                   //
#include <iarduino_Modbus.h>                                                       //   Подключаем библиотеку для работы по протоколу Modbus.
#include <iarduino_MB_ShtSgpLtr.h>                                                 //   Подключаем библиотеку для работы с модулем климатических датчиков.
                                                                                   //
ModbusClient          modbus(Serial1, 2);                                          //   Создаём объект для работы по протоколу Modbus указывая объект шины UART-RS485 для протокола и вывод DE конвертера UART-RS485.
iarduino_MB_ShtSgpLtr sensor(modbus);                                              //   Создаём объект для работы с модулем климатических датчиков указывая объект протокола Modbus.
                                                                                   //
void setup(){                                                                      //
     Serial.begin(9600); while(!Serial);                                           //   Инициируем передачу данных в монитор последовательного порта, указав его скорость.
     Serial1.begin(9600); while(!Serial1);                                         //   Инициируем работу с шиной UART-RS485 указав её скорость.
     modbus.begin();                                                               //   Инициируем работу по протоколу Modbus.
//   modbus.setTimeout(10);                                                        //   Указываем максимальное время ожидания ответа по протоколу Modbus.
//   modbus.setDelay(4);                                                           //   Указываем минимальный интервал между отправляемыми сообщениями по протоколу Modbus.
//   modbus.setTypeMB( MODBUS_RTU );                                               //   Указываем тип протокола Modbus: MODBUS_RTU (по умолчанию), или MODBUS_ASCII.
     sensor.begin(3);                                                              //   Инициируем работу с модулем климатических датчиков, указав его адрес. Если адрес не указан sensor.begin(), то он будет найден, но это займёт некоторое время.
//   sensor.setPeriod( SENSOR_SHT, 0.5f );                                         //   Указываем модулю обновлять данные датчика влажности и температуры каждые 0.5 секунд.
//   sensor.setPeriod( SENSOR_LTR, 1.0f );                                         //   Указываем модулю обновлять данные датчика освещённости каждую секунду.
//   sensor.setPeriod( SENSOR_SGP, 1.0f );                                         //   Указываем модулю обновлять данные датчика углекислого газа каждую секунду.
}                                                                                  //
                                                                                   //
void loop(){                                                                       //
//   Задержка (не обязательно):                                                    //
     delay(1000);                                                                  //
                                                                                   //
//   Проверяем работу датчиков (не обязательно):                                   //
     int8_t err = sensor.checkSensor(SENSOR_ALL);                                  //   Проверяем все датчики модуля. Можно проверить конкретный датчик: SENSOR_SHT, SENSOR_LTR, или SENSOR_SGP.
     if( err<0 ){ Serial.println("Модуль не отвечает"); delay(1000); return;    }  //   Ошибка чтения данных из модуля. Модуль не отвечает.
                                                                                   //
     if( err                  )    { Serial.println("Обнаружены ошибки:");      }  //   Ошибка модуля, невозможно проверить датчики.
     if( err & ERROR_SHT_INIT )    { Serial.println("- неисправен датчик SHT"); }  //   Модуль не смог инициировать датчик влажности и температуры.
     if( err & ERROR_SHT_DATA )    { Serial.println("- ошибка чтения SHT");     }  //   Модуль выявил ошибку при чтении данных из датчика влажности и температуры.
     if( err & ERROR_SGP_INIT )    { Serial.println("- неисправен датчик SGP"); }  //   Модуль не смог инициировать датчик углекислого газа.
     if( err & ERROR_SGP_DATA )    { Serial.println("- ошибка чтения SGP");     }  //   Модуль выявил ошибку при чтении данных из датчика углекислого газа.
     if( err & ERROR_LTR_INIT )    { Serial.println("- неисправен датчик LTR"); }  //   Модуль не смог инициировать датчик освещённости.
     if( err & ERROR_LTR_DATA )    { Serial.println("- ошибка чтения LTR");     }  //   Модуль выявил ошибку при чтении данных из датчика освещённости.
     if( err                  )    { sensor.reset(); delay(1000); return;       }  //   Если есть любая ошибка, то перезагружаем модуль. Датчики модуля будут переинициированы.
                                                                                   //
     float data;                                                                   //   Объявляем переменную для получения данных.
                                                                                   //
//   Читаем температуру:                                                           //
     data = sensor.getTEM();         Serial.print("TEM=" );                        //   Читаем данные.
     if( data < -40 )              { Serial.print("ERROR"); }                      //   Сообщаем об ошибке чтения.
     else                          { Serial.print(data, 1); }                      //   Выводим данные с одном знаком после запятой.
                                     Serial.print("°C, " );                        //   Выводим единицы измерения.
//   Читаем относительную влажность:                                               //
     data = sensor.getHUM();         Serial.print("HUM=" );                        //   Читаем данные.
     if( data < 0 )                { Serial.print("ERROR"); }                      //   Сообщаем об ошибке чтения.
     else                          { Serial.print(data, 1); }                      //   Выводим данные с одном знаком после запятой.
                                     Serial.print("%, "  );                        //   Выводим единицы измерения.
//   Читаем абсолютную влажность:                                                  //
     data = sensor.getHUMA();        Serial.print("HUM=" );                        //   Читаем данные.
     if( data < 0 )                { Serial.print("ERROR"); }                      //   Сообщаем об ошибке чтения.
     else                          { Serial.print(data, 2); }                      //   Выводим данные с двумя знаками после запятой.
                                     Serial.print("г/м3, ");                       //   Выводим единицы измерения.
//   Читаем освещённость:                                                          //
     data = sensor.getLUX();         Serial.print("LUX=" );                        //   Читаем данные.
     if( data < 0 )                { Serial.print("ERROR"); }                      //   Сообщаем об ошибке чтения.
     else                          { Serial.print(data, 0); }                      //   Выводим данные целочисленно.
                                     Serial.print("лк, " );                        //   Выводим единицы измерения.
                                                                                   //
//   Проверяем количество датчиков у модуля:                                       //   Модули поставляются с 2 или 3 датчиками.
     if( sensor.getSumSensors()<3 ){ Serial.println(); return; }                   //   Если у модуля не 3 датчика, значит СО2 не читаем.
                                                                                   //
//   Читаем количество эквивалента СО2 (углекислого газа):                         //
     data = sensor.getCO2();         Serial.print("CO2=" );                        //   Читаем данные.
     if( data < 0 )                { Serial.print("ERROR"); }                      //   Сообщаем об ошибке чтения.
     else                          { Serial.print(data, 0); }                      //   Выводим данные целочисленно.
                                     Serial.print("ppm, ");                        //   Выводим единицы измерения.
//   Читаем общее количество летучих органических соединений:                      //
     data = sensor.getTVOC();        Serial.print("TVOC=");                        //   Читаем данные.
     if( data < 0 )                { Serial.print("ERROR"); }                      //   Сообщаем об ошибке чтения.
     else                          { Serial.print(data, 0); }                      //   Выводим данные целочисленно.
                                     Serial.print("ppb.\r\n");                     //   Выводим единицы измерения.
}                                                                                  //